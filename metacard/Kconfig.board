## metacard/Kconfig.board
```kconfig
# STM32 Nucleo-64 development board with STM32L072CZT7 MCU configuration

# Copyright (c) 2021 Carlos Rodriguez Peralta <carlos.rodriguez@metadata.es>
# SPDX-License-Identifier: Apache-2.0

config BOARD_METACARD
	bool "Metacard Board"
	select HAS_DTS_GPIO
	depends on SOC_STM32L072XX
```

## metacard/Kconfig.defconfig
```kconfig
# STM32 Nucleo-64 development board with STM32L072CZT7 MCU

# Copyright (c) 2021 Carlos Rodriguez Peralta <carlos.rodriguez@metadata.es>
# SPDX-License-Identifier: Apache-2.0

if BOARD_METACARD

config BOARD
	default "metacard"

config SPI_STM32_INTERRUPT
	default y
	depends on SPI

	

endif # BOARD_METACARD
```
